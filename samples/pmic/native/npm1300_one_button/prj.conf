## prj.conf
```kconfig
# Copyright (c) 2023 Nordic Semiconductor ASA
# SPDX-License-Identifier: LicenseRef-Nordic-5-Clause

CONFIG_SHELL=y
CONFIG_LOG=y
CONFIG_LED=y
CONFIG_GPIO=y
CONFIG_REGULATOR=y
CONFIG_SENSOR=y
CONFIG_I2C_SHELL=y
CONFIG_LOG_CMDS=y

# ensure use nrf54l15 INTERNAL CLOCK
CONFIG_CLOCK_CONTROL_NRF_K32SRC_RC=y
```

## src/main.c
```c
/*
 * Copyright (c) 2023 Nordic Semiconductor ASA
 * SPDX-License-Identifier: LicenseRef-Nordic-5-Clause
 */

#include <stdlib.h>

#include <zephyr/devicetree.h>
#include <zephyr/kernel.h>
#include <zephyr/device.h>
#include <zephyr/drivers/gpio.h>
#include <zephyr/drivers/led.h>
#include <zephyr/drivers/mfd/npm13xx.h>
#include <zephyr/drivers/regulator.h>
#include <zephyr/drivers/sensor.h>
#include <zephyr/sys/printk.h>

#define FAST_FLASH_MS	100
#define SLOW_FLASH_MS	500
#define PRESS_SHORT_MS	1000
#define PRESS_MEDIUM_MS 5000

static volatile int flash_time_ms = SLOW_FLASH_MS;
static volatile bool vbus_connected;

static const struct device *pmic = DEVICE_DT_GET(DT_NODELABEL(npm1300_ek_pmic));
static const struct device *leds = DEVICE_DT_GET(DT_NODELABEL(npm1300_ek_leds));
static const struct device *regulators = DEVICE_DT_GET(DT_NODELABEL(npm1300_ek_regulators));
static const struct device *ldsw = DEVICE_DT_GET(DT_NODELABEL(npm1300_ek_ldo1));
static const struct device *charger = DEVICE_DT_GET(DT_NODELABEL(npm1300_ek_charger));

#if DT_HAS_ALIAS(led0)
static const struct gpio_dt_spec dk_led0 = GPIO_DT_SPEC_GET(DT_ALIAS(led0), gpios);
#define HAVE_DK_LED0 1
#else
#define HAVE_DK_LED0 0
#endif

static void event_callback(const struct device *dev, struct gpio_callback *cb, uint32_t pins)
{
	static int press_t;

	if (pins & BIT(NPM13XX_EVENT_SHIPHOLD_PRESS)) {
		press_t = k_uptime_get();
	}

	if (pins & BIT(NPM13XX_EVENT_SHIPHOLD_RELEASE)) {
		press_t = k_uptime_get() - press_t;

		if (press_t < PRESS_SHORT_MS) {
			printk("Short press\n");
			if (!regulator_is_enabled(ldsw)) {
				regulator_enable(ldsw);
			}
			flash_time_ms = FAST_FLASH_MS;
		} else if (press_t < PRESS_MEDIUM_MS) {
			printk("Medium press\n");
			if (regulator_is_enabled(ldsw)) {
				regulator_disable(ldsw);
			}
			flash_time_ms = SLOW_FLASH_MS;
		} else {
			printk("Long press\n");
			if (vbus_connected) {
				printk("Ship mode entry not possible with USB connected\n");
			} else {
				regulator_parent_ship_mode(regulators);
			}
		}
	}

	if (pins & BIT(NPM13XX_EVENT_VBUS_DETECTED)) {
		printk("Vbus connected\n");
		vbus_connected = true;
	}

	if (pins & BIT(NPM13XX_EVENT_VBUS_REMOVED)) {
		printk("Vbus removed\n");
		vbus_connected = false;
	}
}

bool configure_events(void)
{
	if (!device_is_ready(pmic)) {
		printk("Pmic device not ready.\n");
		return false;
	}

	if (!device_is_ready(regulators)) {
		printk("Regulator device not ready.\n");
		return false;
	}

	if (!device_is_ready(ldsw)) {
		printk("Load switch device not ready.\n");
		return false;
	}

	if (!device_is_ready(charger)) {
		printk("Charger device not ready.\n");
		return false;
	}

	static struct gpio_callback event_cb;

	gpio_init_callback(&event_cb, event_callback,
			   BIT(NPM13XX_EVENT_SHIPHOLD_PRESS) | BIT(NPM13XX_EVENT_SHIPHOLD_RELEASE) |
				   BIT(NPM13XX_EVENT_VBUS_DETECTED) |
				   BIT(NPM13XX_EVENT_VBUS_REMOVED));

	mfd_npm13xx_add_callback(pmic, &event_cb);

	/* Initialise vbus detection status */
	struct sensor_value val;
	int ret = sensor_attr_get(charger, SENSOR_CHAN_CURRENT, SENSOR_ATTR_UPPER_THRESH, &val);

	if (ret < 0) {
		return false;
	}

	vbus_connected = (val.val1 != 0) || (val.val2 != 0);

	return true;
}

int main(void)
{
	bool pmic_ok = true;

#if HAVE_DK_LED0
	if (!device_is_ready(dk_led0.port)) {
		printk("Warning: DK led0 GPIO device not ready\n");
	} else {
		int ret = gpio_pin_configure_dt(&dk_led0, GPIO_OUTPUT_INACTIVE);

		if (ret < 0) {
			printk("Warning: DK led0 configure failed (%d)\n", ret);
		}
	}
#endif

	if (!device_is_ready(leds)) {
		printk("Warning: nPM1300 EK led device not ready\n");
		pmic_ok = false;
	}

	if (!configure_events()) {
		printk("Warning: could not configure PMIC events\n");
		pmic_ok = false;
	}

	if (pmic_ok) {
		printk("PMIC device ok\n");
	}

	while (1) {
		if (pmic_ok) {
			led_on(leds, 2U);
		}
#if HAVE_DK_LED0
		if (device_is_ready(dk_led0.port)) {
			gpio_pin_set_dt(&dk_led0, 1);
		}
#endif
		k_msleep(flash_time_ms);
		if (pmic_ok) {
			led_off(leds, 2U);
		}
#if HAVE_DK_LED0
		if (device_is_ready(dk_led0.port)) {
			gpio_pin_set_dt(&dk_led0, 0);
		}
#endif
		k_msleep(flash_time_ms);
	}
}
```
